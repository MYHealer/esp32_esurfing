## main/Kconfig.projbuild
```kconfig
menu "ESurfingClient 配置"

    config ESURF_WIFI_SSID
        string "WiFi SSID (校园网名称)"
        default "ChinaNet"
        help
            输入要连接的天翼校园网 WiFi SSID。

    config ESURF_WIFI_PASSWORD
        string "WiFi 密码"
        default ""
        help
            输入校园网 WiFi 密码。
            如为开放网络 (无密码), 留空即可。

endmenu
```

## sdkconfig.defaults
```kconfig
CONFIG_ESP_WIFI_SOFTAP_SUPPORT=y
# CONFIG_ESP_WIFI_ENABLE_WPA3_SAE is not set
# CONFIG_ESP_WIFI_AMPDU_TX_ENABLED is not set
# CONFIG_ESP_WIFI_AMPDU_RX_ENABLED is not set
# CONFIG_ESP_WIFI_STA_DISCONNECTED_PM_ENABLE is not set
CONFIG_ESPTOOLPY_FLASHSIZE_4MB=y
CONFIG_PARTITION_TABLE_CUSTOM=y
CONFIG_PARTITION_TABLE_CUSTOM_FILENAME="partitions.csv"
CONFIG_FREERTOS_HZ=100
CONFIG_ESP_MAIN_TASK_STACK_SIZE=8192
CONFIG_SPIFFS_SUPPORT=y
CONFIG_SPIFFS_CACHE=y
CONFIG_SPIFFS_MAX_PARTITIONS=1
CONFIG_ESURF_WIFI_SSID=""
CONFIG_ESURF_WIFI_PASSWORD=""
```
